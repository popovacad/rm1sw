const u16 mel_doremido[] = {
NOTE_C1, LEN_E, NOTE_D1, LEN_E, NOTE_E1, LEN_E, NOTE_C1, LEN_E, NOTE_D1, LEN_Q, NOTE_C1, LEN_Q-LEN_S, NOTE_PAU, LEN_S, \
NOTE_G1, LEN_E, NOTE_F1, LEN_E, NOTE_E1, LEN_E, NOTE_D1, LEN_E, NOTE_C1, LEN_H-LEN_Q
};

const u16 mel_start[] = {
NOTE_C1, LEN_E, NOTE_G1, LEN_E, NOTE_E2, LEN_E
};

const u16 mel_normal[] = {
NOTE_C2, LEN_S, NOTE_PAU, LEN_S, NOTE_C2, LEN_S, NOTE_PAU, LEN_S, NOTE_C2, LEN_S
};

const u16 mel_leta1[] = {
NOTE_E2, LEN_Q-LEN_S, NOTE_PAU, LEN_S, NOTE_E2, LEN_E, NOTE_D2, LEN_E, NOTE_E2, LEN_Q, NOTE_C2, LEN_Q-LEN_S, NOTE_PAU, LEN_S, \
NOTE_E2, LEN_Q-LEN_S, NOTE_PAU, LEN_S, NOTE_E2, LEN_E, NOTE_D2, LEN_E, NOTE_E2, LEN_Q, NOTE_C2, LEN_Q-LEN_S, NOTE_PAU, LEN_S, \
NOTE_E2, LEN_Q-LEN_S, NOTE_PAU, LEN_S, NOTE_E2, LEN_E-LEN_S, NOTE_PAU, LEN_S, NOTE_E2, LEN_E-LEN_S, NOTE_PAU, LEN_S, NOTE_F2, LEN_E, NOTE_E2, LEN_E, NOTE_D2, LEN_E, NOTE_C2, LEN_E, \
NOTE_D2, LEN_E, NOTE_C2, LEN_E, NOTE_B2, LEN_E, NOTE_A2, LEN_E, NOTE_B2, LEN_E, NOTE_C2, LEN_E, NOTE_D2, LEN_E, NOTE_PAU, LEN_E
};

const u16 mel_leta2[] = {
NOTE_C2, LEN_Q-LEN_S, NOTE_PAU, LEN_S, NOTE_C2, LEN_E, NOTE_G1, LEN_E, NOTE_C2, LEN_Q, NOTE_E1, LEN_Q-LEN_S, NOTE_PAU, LEN_S, \
NOTE_C2, LEN_Q-LEN_S, NOTE_PAU, LEN_S, NOTE_C2, LEN_E, NOTE_G1, LEN_E, NOTE_C2, LEN_Q, NOTE_E1, LEN_Q-LEN_S, NOTE_PAU, LEN_S, \
NOTE_C1, LEN_Q-LEN_S, NOTE_PAU, LEN_S, NOTE_C1, LEN_E-LEN_S, NOTE_PAU, LEN_S, NOTE_C1, LEN_E-LEN_S, NOTE_PAU, LEN_S, NOTE_C1, LEN_Q-LEN_S, NOTE_PAU, LEN_S, NOTE_C1, LEN_E-LEN_S, NOTE_PAU, LEN_S, NOTE_C1, LEN_E-LEN_S, NOTE_PAU, LEN_S, \
NOTE_G1, LEN_Q-LEN_S, NOTE_PAU, LEN_S, NOTE_G1, LEN_E-LEN_S, NOTE_PAU, LEN_S, NOTE_G1, LEN_E-LEN_S, NOTE_PAU, LEN_S, NOTE_G1, LEN_Q-LEN_S, NOTE_PAU, LEN_S, NOTE_G1, LEN_Q-LEN_S, NOTE_PAU, LEN_S
};
