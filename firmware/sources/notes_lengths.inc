// Notes (autoreload values for timer counting at 16 MHz)
#define NOTE_A0 36364
#define NOTE_Ais0 34323
#define NOTE_B0 32396
#define NOTE_C0 30578
#define NOTE_Cis0 28862
#define NOTE_D0 27242
#define NOTE_Dis0 25713
#define NOTE_E0 24270
#define NOTE_F0 22908
#define NOTE_Fis0 21622
#define NOTE_G0 20408
#define NOTE_Gis0 19263
#define NOTE_A1 18182
#define NOTE_Ais1 17161
#define NOTE_B1 16198
#define NOTE_C1 15289
#define NOTE_Cis1 14431
#define NOTE_D1 13621
#define NOTE_Dis1 12856
#define NOTE_E1 12135
#define NOTE_F1 11454
#define NOTE_Fis1 10811
#define NOTE_G1 10204
#define NOTE_Gis1 9631
#define NOTE_A2 9091
#define NOTE_Ais2 8581
#define NOTE_B2 8099
#define NOTE_C2 7645
#define NOTE_Cis2 7215
#define NOTE_D2 6810
#define NOTE_Dis2 6428
#define NOTE_E2 6067
#define NOTE_F2 5727
#define NOTE_Fis2 5405
#define NOTE_G2 5102
#define NOTE_Gis2 4816
#define NOTE_A3 4545

// Pause (no sound)
#define NOTE_PAU 0

// Lengths (in ms)
#define LEN_F 700
#define LEN_H LEN_F/2
#define LEN_Q LEN_F/4
#define LEN_E LEN_F/8
#define LEN_S LEN_F/16
